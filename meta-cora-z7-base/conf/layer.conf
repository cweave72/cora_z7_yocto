## meta-cora-z7-base/conf/layer.conf
```bitbake
# We have a conf and classes directory, add to BBPATH
BBPATH .= ":${LAYERDIR}"

# We have a packages directory, add to BBFILES
BBFILES += "${LAYERDIR}/recipes-*/*/*.bb"
BBFILES += "${LAYERDIR}/recipes-*/*/*.bbappend"

BBFILE_COLLECTIONS += "meta-cora-z7-base"
BBFILE_PATTERN_meta-cora-z7-base = "^${LAYERDIR}/"
BBFILE_PRIORITY_meta-cora-z7-base = "6"

LAYERDEPENDS_meta-cora-z7-base = "core"
LAYERDEPENDS_meta-cora-z7-base = "xilinx"

LAYERSERIES_COMPAT_meta-cora-z7-base = "sumo thud warrior"

XILINX_RELEASE_VERSION = "v2018.2"
```

## meta-cora-z7-base/conf/machine/cora-zynq7.conf
```bitbake
#@TYPE: Machine
#@NAME: cora-z7
#@DESCRIPTION: Machine support for Cora Z7.

SOC_VARIANT ?= "7z"
IMAGE_FSTYPES ?= "tar.gz"

require conf/machine/include/tune-zynq.inc
require conf/machine/include/machine-xilinx-overrides.inc
require conf/machine/include/machine-xilinx-default.inc
require conf/machine/include/machine-xilinx-board.inc

MACHINE_FEATURES = "ext2 ext3 vfat usbhost"

# u-boot configuration
PREFERRED_PROVIDER_virtual/bootloader = "u-boot-xlnx"
UBOOT_MACHINE = "zynq_coraz7_defconfig"
SPL_BINARY = "spl/boot.bin"

EXTRA_IMAGEDEPENDS += " \
        u-boot-zynq-uenv \
        virtual/bootloader \
        cora-zynq7-linux-bd \
        "

SERIAL_CONSOLES ?= "115200;ttyPS0"

MACHINE_ESSENTIAL_EXTRA_RDEPENDS += "device-tree"

IMAGE_BOOT_FILES += " \
        boot.bin \
        uEnv.txt \
        fpga.bin \
        system-top.dtb \
        "
```
